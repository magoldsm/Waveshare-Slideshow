## sdkconfig.defaults
```kconfig
CONFIG_ESPTOOLPY_FLASHSIZE_16MB=y
CONFIG_ESPTOOLPY_HEADER_FLASHSIZE_UPDATE=y
CONFIG_PARTITION_TABLE_SINGLE_APP_LARGE=y
CONFIG_SPIRAM=y
CONFIG_SPIRAM_MODE_OCT=y
CONFIG_SPIRAM_SPEED_40M=y
CONFIG_LV_USE_FS_STDIO=y
CONFIG_LV_FS_STDIO_LETTER=83
CONFIG_LV_FS_DEFAULT_DRIVER_LETTER=83
CONFIG_LV_USE_CLIB_MALLOC=y
CONFIG_LV_USE_FS_MEMFS=y
CONFIG_LV_FS_MEMFS_LETTER=77
CONFIG_LV_USE_LODEPNG=y
CONFIG_LV_USE_TJPGD=y
CONFIG_LV_USE_BMP=y
CONFIG_BSP_SD_MOUNT_POINT="/sdcard"
CONFIG_BSP_I2C_FAST_MODE=n
CONFIG_BSP_I2C_CLK_SPEED_HZ=100000
CONFIG_ESP_MAIN_TASK_STACK_SIZE=8192
CONFIG_FATFS_LFN_HEAP=y
CONFIG_FATFS_MAX_LFN=255
CONFIG_BSP_LCD_RGB_BUFFER_NUMS=2
CONFIG_BSP_DISPLAY_LVGL_BUF_HEIGHT=100
```
